#include <Arduino.h> // L0001
#include <vector> // L0002
#include <TFT_eSPI.h> // L0003
// L0004
void DrawBackground(); // L0005
void DrawBall(); // L0006
// L0007
// L0008
// Runtime helpers generated by transpiler // L0009
static std::vector<String> __vb_split(const String& input, const String& delim) { // L0010
    std::vector<String> parts; // L0011
    int start = 0; // L0012
    int idx = 0; // L0013
    if (delim.length() == 0) { parts.push_back(input); return parts; } // L0014
    while ((idx = input.indexOf(delim, start)) != -1) { // L0015
        parts.push_back(input.substring(start, idx)); // L0016
        start = idx + delim.length(); // L0017
    } // L0018
    parts.push_back(input.substring(start)); // L0019
    return parts; // L0020
} // L0021
// L0022
static String __vb_join(const std::vector<String>& parts, const String& delim) { // L0023
    String out = ""; // L0024
    for (size_t i = 0; i < parts.size(); ++i) { // L0025
        out += parts[i]; // L0026
        if (i + 1 < parts.size()) out += delim; // L0027
    } // L0028
    return out; // L0029
} // L0030
// L0031
static std::vector<String> __vb_filter(const std::vector<String>& parts, const String& match) { // L0032
    std::vector<String> out; // L0033
    for (const auto& p : parts) { // L0034
        if (p.indexOf(match) != -1) out.push_back(p); // L0035
    } // L0036
    return out; // L0037
} // L0038
// L0039
TFT_eSPI tft; // L0040
// __VB_LINE__:6 // L0041
const auto SCREEN_W = 240; // L0042
// __VB_LINE__:7 // L0043
const auto SCREEN_H = 240; // L0044
// __VB_LINE__:8 // L0045
const auto BALL_RADIUS = 40; // L0046
// __VB_LINE__:9 // L0047
const auto BALL_TILES = 8; // L0048
// __VB_LINE__:10 // L0049
const auto BALL_SPEED_X = 3.2; // L0050
// __VB_LINE__:11 // L0051
const auto BALL_SPEED_Y = 0.09; // L0052
// __VB_LINE__:12 // L0053
const auto FLOOR_GRID = 8; // L0054
// __VB_LINE__:13 // L0055
const auto COLOR_BG = TFT_DARKGREY; // L0056
// __VB_LINE__:14 // L0057
const auto COLOR_GRID = TFT_MAGENTA; // L0058
// __VB_LINE__:15 // L0059
const auto COLOR_SHADOW = TFT_DARKGREY; // L0060
// __VB_LINE__:16 // L0061
const auto COLOR_RED = TFT_RED; // L0062
// __VB_LINE__:17 // L0063
const auto COLOR_WHITE = TFT_WHITE; // L0064
// __VB_LINE__:19 // L0065
float ballX = 0; // L0066
// __VB_LINE__:20 // L0067
float ballY = 0; // L0068
// __VB_LINE__:21 // L0069
float ballVX = 0; // L0070
// __VB_LINE__:22 // L0071
float ballVY = 0; // L0072
// __VB_LINE__:23 // L0073
float phase = 0; // L0074
// __VB_LINE__:24 // L0075
float shadowY = 0; // L0076
// __VB_LINE__:25 // L0077
float amplitude = 0; // L0078
// __VB_LINE__:26 // L0079
float centerY = 0; // L0080
// __VB_LINE__:27 // L0081
float bounceMargin = 0; // L0082
// __VB_LINE__:28 // L0083
float leftBound = 0; // L0084
// __VB_LINE__:29 // L0085
float rightBound = 0; // L0086
// __VB_LINE__:30 // L0087
bool isMovingRight = false; // L0088
// __VB_LINE__:31 // L0089
bool isMovingUp = false; // L0090
// L0091
void DrawBackground() { // L0092
    float COLOR_BG = 0; // L0093
    float COLOR_GRID = 0; // L0094
    float FLOOR_GRID = 0; // L0095
    float SCREEN_H = 0; // L0096
    float SCREEN_W = 0; // L0097
    float __VB_LINE__ = 0; // L0098
    float drawLine = 0; // L0099
    float fillRect = 0; // L0100
// __VB_LINE__:53 // L0101
tft.fillRect(0, 0, SCREEN_W, SCREEN_H, COLOR_BG); // L0102
// __VB_LINE__:54 // L0103
int i = 0; // L0104
// __VB_LINE__:55 // L0105
float x1v = 0; // L0106
// __VB_LINE__:57 // L0107
float vanishingX = 0; // L0108
// __VB_LINE__:58 // L0109
vanishingX = SCREEN_W / 2; // L0110
// __VB_LINE__:59 // L0111
vanishingY = SCREEN_H * 0.85; // L0112
// __VB_LINE__:61 // L0113
for (int i = 0; ((1) >= 0 ? i <= FLOOR_GRID : i >= FLOOR_GRID); i += (1)) { // L0114
// __VB_LINE__:62 // L0115
x1v = vanishingX; // L0116
// __VB_LINE__:63 // L0117
y1v = vanishingY; // L0118
// __VB_LINE__:64 // L0119
x2v = i * (SCREEN_W / FLOOR_GRID); // L0120
// __VB_LINE__:65 // L0121
y2v = SCREEN_H; // L0122
// __VB_LINE__:66 // L0123
tft.drawLine(x1v, y1v, x2v, y2v, COLOR_GRID); // L0124
// __VB_LINE__:67 // L0125
} // L0126
// __VB_LINE__:69 // L0127
for (int i = 0; ((1) >= 0 ? i <= FLOOR_GRID : i >= FLOOR_GRID); i += (1)) { // L0128
// __VB_LINE__:70 // L0129
y1v = vanishingY + i * ((SCREEN_H - vanishingY) / FLOOR_GRID); // L0130
// __VB_LINE__:71 // L0131
tft.drawLine(0, y1v, SCREEN_W, y1v, COLOR_GRID); // L0132
// __VB_LINE__:72 // L0133
} // L0134
} // L0135
} // L0136
void DrawBall() { // L0137
    float BALL_RADIUS = 0; // L0138
    float BALL_TILES = 0; // L0139
    float COLOR_SHADOW = 0; // L0140
    float TFT_RED = 0; // L0141
    float TFT_WHITE = 0; // L0142
    float __VB_LINE__ = 0; // L0143
    float ballX = 0; // L0144
    float ballY = 0; // L0145
    float cos = 0; // L0146
    float drawCircle = 0; // L0147
    float fillCircle = 0; // L0148
    float fillTriangle = 0; // L0149
    float phase = 0; // L0150
    float shadowY = 0; // L0151
    float sin = 0; // L0152
// __VB_LINE__:77 // L0153
int t = 0; // L0154
// __VB_LINE__:78 // L0155
float angle1v = 0; // L0156
// __VB_LINE__:79 // L0157
float angle2v = 0; // L0158
// __VB_LINE__:80 // L0159
float x1v = 0; // L0160
// __VB_LINE__:81 // L0161
float y1v = 0; // L0162
// __VB_LINE__:82 // L0163
float x2v = 0; // L0164
// __VB_LINE__:83 // L0165
float y2v = 0; // L0166
// __VB_LINE__:84 // L0167
float x3v = 0; // L0168
// __VB_LINE__:85 // L0169
float y3v = 0; // L0170
// __VB_LINE__:86 // L0171
int colorTile = 0; // L0172
// __VB_LINE__:88 // L0173
tft.fillCircle(ballX, shadowY, BALL_RADIUS * 0.7, COLOR_SHADOW); // L0174
// __VB_LINE__:90 // L0175
for (int t = 0; ((1) >= 0 ? t <= BALL_TILES : t >= BALL_TILES); t += (1)) { // L0176
// __VB_LINE__:91 // L0177
angle1v = phase + t * (3.14159 * 2 / BALL_TILES); // L0178
// __VB_LINE__:92 // L0179
angle2v = phase + (t + 1) * (3.14159 * 2 / BALL_TILES); // L0180
// __VB_LINE__:93 // L0181
for (int s = 0; ((1) >= 0 ? s <= 1 : s >= 1); s += (1)) { // L0182
// __VB_LINE__:94 // L0183
x1v = ballX; // L0184
// __VB_LINE__:95 // L0185
y1v = ballY; // L0186
// __VB_LINE__:96 // L0187
x2v = ballX + cos(angle1v) * BALL_RADIUS * (1 - s * 0.5); // L0188
// __VB_LINE__:97 // L0189
y2v = ballY + sin(angle1v) * BALL_RADIUS * (1 - s * 0.5); // L0190
// __VB_LINE__:98 // L0191
x3v = ballX + cos(angle2v) * BALL_RADIUS * (1 - s * 0.5); // L0192
// __VB_LINE__:99 // L0193
y3v = ballY + sin(angle2v) * BALL_RADIUS * (1 - s * 0.5); // L0194
// __VB_LINE__:100 // L0195
if (((t + s) % 2) == 0) { // L0196
// __VB_LINE__:101 // L0197
colorTile = TFT_RED; // L0198
// __VB_LINE__:102 // L0199
} else { // L0200
// __VB_LINE__:103 // L0201
colorTile = TFT_WHITE; // L0202
// __VB_LINE__:104 // L0203
} // L0204
// __VB_LINE__:105 // L0205
tft.fillTriangle(x1v, y1v, x2v, y2v, x3v, y3v, colorTile); // L0206
// __VB_LINE__:106 // L0207
} // L0208
// __VB_LINE__:107 // L0209
} // L0210
// __VB_LINE__:109 // L0211
tft.drawCircle(ballX, ballY, BALL_RADIUS, TFT_WHITE); // L0212
} // L0213
} // L0214
void setup() { // L0215
    delay(1000); // L0216
    tft.begin(); // L0217
    // __VB_LINE__:35 // L0218
    ballX = SCREEN_W / 2; // L0219
    // __VB_LINE__:36 // L0220
    centerY = SCREEN_H * 0.75; // L0221
    // __VB_LINE__:37 // L0222
    amplitude = SCREEN_H * 0.25 - BALL_RADIUS; // L0223
    // __VB_LINE__:38 // L0224
    ballY = centerY; // L0225
    // __VB_LINE__:39 // L0226
    ballVX = BALL_SPEED_X; // L0227
    // __VB_LINE__:40 // L0228
    ballVY = BALL_SPEED_Y; // L0229
    // __VB_LINE__:41 // L0230
    phase = 0; // L0231
    // __VB_LINE__:42 // L0232
    bounceMargin = BALL_RADIUS + 4; // L0233
    // __VB_LINE__:43 // L0234
    leftBound = bounceMargin; // L0235
    // __VB_LINE__:44 // L0236
    rightBound = SCREEN_W - bounceMargin; // L0237
    // __VB_LINE__:45 // L0238
    isMovingRight = true; // L0239
    // __VB_LINE__:46 // L0240
    isMovingUp = false; // L0241
    // __VB_LINE__:47 // L0242
    shadowY = centerY + BALL_RADIUS + 12; // L0243
    // __VB_LINE__:48 // L0244
    DrawBackground(); // L0245
} // L0246
// L0247
void loop() { // L0248
    // __VB_LINE__:113 // L0249
    DrawBackground(); // L0250
    // __VB_LINE__:115 // L0251
    if (isMovingRight) { // L0252
    // __VB_LINE__:116 // L0253
    ballX = ballX + ballVX; // L0254
    // __VB_LINE__:117 // L0255
    phase = phase + 0.18; // L0256
    // __VB_LINE__:118 // L0257
    if (ballX >= rightBound) { // L0258
    // __VB_LINE__:119 // L0259
    isMovingRight = false; // L0260
    // __VB_LINE__:120 // L0261
    } // L0262
    // __VB_LINE__:121 // L0263
    } else { // L0264
    // __VB_LINE__:122 // L0265
    ballX = ballX - ballVX; // L0266
    // __VB_LINE__:123 // L0267
    phase = phase - 0.18; // L0268
    // __VB_LINE__:124 // L0269
    if (ballX <= leftBound) { // L0270
    // __VB_LINE__:125 // L0271
    isMovingRight = true; // L0272
    // __VB_LINE__:126 // L0273
    } // L0274
    // __VB_LINE__:127 // L0275
    } // L0276
    // __VB_LINE__:128 // L0277
    ballY = centerY - amplitude * abs(cos(phase * ballVY)); // L0278
    // __VB_LINE__:129 // L0279
    if (ballY < centerY) { // L0280
    // __VB_LINE__:130 // L0281
    isMovingUp = true; // L0282
    // __VB_LINE__:131 // L0283
    } else { // L0284
    // __VB_LINE__:132 // L0285
    isMovingUp = false; // L0286
    // __VB_LINE__:133 // L0287
    } // L0288
    // __VB_LINE__:134 // L0289
    DrawBall(); // L0290
    } // L0291
// L0292
} // L0293
