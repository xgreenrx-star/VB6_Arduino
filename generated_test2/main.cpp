#include <Arduino.h> // L0001
#include <vector> // L0002
#include <TFT_eSPI.h> // L0003
// L0004
void DrawBackground(); // L0005
void DrawBall(); // L0006
// L0007
// L0008
// Runtime helpers generated by transpiler // L0009
static std::vector<String> __vb_split(const String& input, const String& delim) { // L0010
    std::vector<String> parts; // L0011
    int start = 0; // L0012
    int idx = 0; // L0013
    if (delim.length() == 0) { parts.push_back(input); return parts; } // L0014
    while ((idx = input.indexOf(delim, start)) != -1) { // L0015
        parts.push_back(input.substring(start, idx)); // L0016
        start = idx + delim.length(); // L0017
    } // L0018
    parts.push_back(input.substring(start)); // L0019
    return parts; // L0020
} // L0021
// L0022
static String __vb_join(const std::vector<String>& parts, const String& delim) { // L0023
    String out = ""; // L0024
    for (size_t i = 0; i < parts.size(); ++i) { // L0025
        out += parts[i]; // L0026
        if (i + 1 < parts.size()) out += delim; // L0027
    } // L0028
    return out; // L0029
} // L0030
// L0031
static std::vector<String> __vb_filter(const std::vector<String>& parts, const String& match) { // L0032
    std::vector<String> out; // L0033
    for (const auto& p : parts) { // L0034
        if (p.indexOf(match) != -1) out.push_back(p); // L0035
    } // L0036
    return out; // L0037
} // L0038
// L0039
TFT_eSPI tft; // L0040
// __VB_LINE__:6 // L0041
const auto SCREEN_W = 240; // L0042
// __VB_LINE__:7 // L0043
const auto SCREEN_H = 240; // L0044
// __VB_LINE__:8 // L0045
const auto BALL_RADIUS = 40; // L0046
// __VB_LINE__:9 // L0047
const auto BALL_TILES = 8; // L0048
// __VB_LINE__:10 // L0049
const auto BALL_SPEED_X = 3.2; // L0050
// __VB_LINE__:11 // L0051
const auto BALL_SPEED_Y = 0.09; // L0052
// __VB_LINE__:12 // L0053
const auto FLOOR_GRID = 8; // L0054
// __VB_LINE__:13 // L0055
const auto COLOR_BG = TFT_DARKGREY; // L0056
// __VB_LINE__:14 // L0057
const auto COLOR_GRID = TFT_MAGENTA; // L0058
// __VB_LINE__:15 // L0059
const auto COLOR_SHADOW = TFT_DARKGREY; // L0060
// __VB_LINE__:16 // L0061
const auto COLOR_RED = TFT_RED; // L0062
// __VB_LINE__:17 // L0063
const auto COLOR_WHITE = TFT_WHITE; // L0064
// __VB_LINE__:19 // L0065
float ballX = 0; // L0066
// __VB_LINE__:20 // L0067
float ballY = 0; // L0068
// __VB_LINE__:21 // L0069
float ballVX = 0; // L0070
// __VB_LINE__:22 // L0071
float ballVY = 0; // L0072
// __VB_LINE__:23 // L0073
float phase = 0; // L0074
// __VB_LINE__:24 // L0075
float shadowY = 0; // L0076
// __VB_LINE__:25 // L0077
float amplitude = 0; // L0078
// __VB_LINE__:26 // L0079
float centerY = 0; // L0080
// __VB_LINE__:27 // L0081
float bounceMargin = 0; // L0082
// __VB_LINE__:28 // L0083
float leftBound = 0; // L0084
// __VB_LINE__:29 // L0085
float rightBound = 0; // L0086
// __VB_LINE__:30 // L0087
bool isMovingRight = false; // L0088
// __VB_LINE__:31 // L0089
bool isMovingUp = false; // L0090
// L0091
void DrawBackground() { // L0092
void DrawBall() { // L0093
void setup() { // L0094
    delay(1000); // L0095
    tft.begin(); // L0096
    // __VB_LINE__:35 // L0097
    ballX = SCREEN_W / 2; // L0098
    // __VB_LINE__:36 // L0099
    centerY = SCREEN_H * 0.75; // L0100
    // __VB_LINE__:37 // L0101
    amplitude = SCREEN_H * 0.25 - BALL_RADIUS; // L0102
    // __VB_LINE__:38 // L0103
    ballY = centerY; // L0104
    // __VB_LINE__:39 // L0105
    ballVX = BALL_SPEED_X; // L0106
    // __VB_LINE__:40 // L0107
    ballVY = BALL_SPEED_Y; // L0108
    // __VB_LINE__:41 // L0109
    phase = 0; // L0110
    // __VB_LINE__:42 // L0111
    bounceMargin = BALL_RADIUS + 4; // L0112
    // __VB_LINE__:43 // L0113
    leftBound = bounceMargin; // L0114
    // __VB_LINE__:44 // L0115
    rightBound = SCREEN_W - bounceMargin; // L0116
    // __VB_LINE__:45 // L0117
    isMovingRight = true; // L0118
    // __VB_LINE__:46 // L0119
    isMovingUp = false; // L0120
    // __VB_LINE__:47 // L0121
    shadowY = centerY + BALL_RADIUS + 12; // L0122
    // __VB_LINE__:48 // L0123
    DrawBackground(); // L0124
} // L0125
// L0126
void loop() { // L0127
    // __VB_LINE__:113 // L0128
    DrawBackground(); // L0129
    // __VB_LINE__:115 // L0130
    if (isMovingRight) { // L0131
    // __VB_LINE__:116 // L0132
    ballX = ballX + ballVX; // L0133
    // __VB_LINE__:117 // L0134
    phase = phase + 0.18; // L0135
    // __VB_LINE__:118 // L0136
    if (ballX >= rightBound) { // L0137
    // __VB_LINE__:119 // L0138
    isMovingRight = false; // L0139
    // __VB_LINE__:120 // L0140
    } // L0141
    // __VB_LINE__:121 // L0142
    } else { // L0143
    // __VB_LINE__:122 // L0144
    ballX = ballX - ballVX; // L0145
    // __VB_LINE__:123 // L0146
    phase = phase - 0.18; // L0147
    // __VB_LINE__:124 // L0148
    if (ballX <= leftBound) { // L0149
    // __VB_LINE__:125 // L0150
    isMovingRight = true; // L0151
    // __VB_LINE__:126 // L0152
    } // L0153
    // __VB_LINE__:127 // L0154
    } // L0155
    // __VB_LINE__:128 // L0156
    ballY = centerY - amplitude * abs(cos(phase * ballVY)); // L0157
    // __VB_LINE__:129 // L0158
    if (ballY < centerY) { // L0159
    // __VB_LINE__:130 // L0160
    isMovingUp = true; // L0161
    // __VB_LINE__:131 // L0162
    } else { // L0163
    // __VB_LINE__:132 // L0164
    isMovingUp = false; // L0165
    // __VB_LINE__:133 // L0166
    } // L0167
    // __VB_LINE__:134 // L0168
    DrawBall(); // L0169
    } // L0170
// L0171
} // L0172
