#include <Arduino.h> // L0001
#include <vector> // L0002
// L0003
// L0004
// Runtime helpers generated by transpiler // L0005
static std::vector<String> __vb_split(const String& input, const String& delim) { // L0006
    std::vector<String> parts; // L0007
    int start = 0; // L0008
    int idx = 0; // L0009
    if (delim.length() == 0) { parts.push_back(input); return parts; } // L0010
    while ((idx = input.indexOf(delim, start)) != -1) { // L0011
        parts.push_back(input.substring(start, idx)); // L0012
        start = idx + delim.length(); // L0013
    } // L0014
    parts.push_back(input.substring(start)); // L0015
    return parts; // L0016
} // L0017
// L0018
static String __vb_join(const std::vector<String>& parts, const String& delim) { // L0019
    String out = ""; // L0020
    for (size_t i = 0; i < parts.size(); ++i) { // L0021
        out += parts[i]; // L0022
        if (i + 1 < parts.size()) out += delim; // L0023
    } // L0024
    return out; // L0025
} // L0026
// L0027
static std::vector<String> __vb_filter(const std::vector<String>& parts, const String& match) { // L0028
    std::vector<String> out; // L0029
    for (const auto& p : parts) { // L0030
        if (p.indexOf(match) != -1) out.push_back(p); // L0031
    } // L0032
    return out; // L0033
} // L0034
// L0035
// __VB_LINE__:2 // L0036
const auto LED = 2; // L0037
// L0038
void setup() { // L0039
    delay(1000); // L0040
    // __VB_LINE__:5 // L0041
    pinMode(LED, OUTPUT); // L0042
} // L0043
// L0044
void loop() { // L0045
    // __VB_LINE__:9 // L0046
    digitalWrite(LED, HIGH); // L0047
    // __VB_LINE__:10 // L0048
    delay(1000); // L0049
    // __VB_LINE__:11 // L0050
    digitalWrite(LED, LOW); // L0051
    // __VB_LINE__:12 // L0052
    delay(1000); // L0053
} // L0054
